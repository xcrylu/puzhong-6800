/**
 * @file key.c
 * @brief 4×4矩阵键盘扫描驱动
 *
 * @version 1.0
 * @date 2026-05-29
 * @author xcr
 *
 * @details
 * 本文件实现了4×4矩阵键盘的扫描功能，支持按键检测、消抖和键值查表。
 *
 * === 硬件连接 ===
 * - KEY_PORT: 按键端口（默认P1口）
 * - 矩阵键盘: 4行 × 4列共16个按键
 * - 行引脚: P1.4~P1.7（高4位）
 * - 列引脚: P1.0~P1.3（低4位）
 *
 * === 功能描述 ===
 * - 全局检测：判断是否有按键按下
 * - 行扫描：确定按下按键的行号
 * - 列扫描：确定按下按键的列号
 * - 查表返回：根据行列号查找键值
 * - 消抖处理：软件延时消抖
 *
 * === 使用方法 ===
 * 1. 定义按键端口（KEY_PORT）
 * 2. 定义按键值表（KeyTable[4][4]）
 * 3. 调用 KeyScan() 扫描按键
 * 4. 返回值：0~15表示按键编号，0xFF表示无按键
 *
 * === 扫描流程 ===
 * 1. 全行拉低，检测是否有按键按下
 * 2. 依次拉低每行，检测行号
 * 3. 全列拉低，检测列号
 * 4. 根据行列号查表返回键值
 *
 * === 注意事项 ===
 * - 需要延时函数 delay_ms()
 * - 按键按下时对应引脚为低电平
 */

#include <reg52.h>



// ==================== 按键模块引脚定义 ====================

#define KEY_PORT ___________________________  // 按键端口定义

// ==================== 函数声明 ====================
void delay_ms(unsigned int);
unsigned char KeyScan(void);



/******************* 按键值表 *****************************/
unsigned int code KeyTable[4][4] = {
   // ============ 请定义自己的键值表 ============


   //------------------end------------------------
};

// ==================== 函数实现 ====================



/*********************************************************
 * 函数：KeyScan（矩阵键盘扫描 - 查表法）
 * 功能：无位定义，纯端口操作，查表返回键值
 * 返回：0xFF 无键按下，非0xFF 有键按下
 *********************************************************/

unsigned int KeyScan(void)
{
    unsigned int row = 0, col = 0, temp, key = 0xff;

    // 第一步：全行拉低，检测是否有按键按下
    KEY_PORT = 0x0F;        // 行： 0000 1111→ 低4位列=1，高4位行=0
    temp = KEY_PORT & 0x0F; // 读取列电平
    if ((temp&0x0F) == 0x0F)
        return 0xFF; // 无按键

    delay_ms(2);
    // 获取行号
    // ============ 请在下面补充程序，完成获取按键的行号 row =？ ============
    // 
    // 行扫描原理：
    // - 矩阵键盘共4行（高4位）和4列（低4位）
    
    // - KEY_PORT 高4位为行，低4位为列
    // 
    // 行号对应关系：
    //   P1.7 P1.6 P1.5 P1.4 | P1.3 P1.2 P1.1 P1.0
    //     D7   D6   D5   D4  |   D3   D2   D1   D0
    //     行3   行2   行1   行0 |   列3   列2   列1   列0

    //  如果某行有按键按下，KEY_PORT & 0x0F 将不等于 0x0F
    // 读取KEY_PORT高4位，判断哪一行有按键
    //   KEY_PORT = 0xE0 → 0b1110 0000 拉低行0
    //   KEY_PORT = 0xD0 → 0b1101 0000 拉低行1
    //   KEY_PORT = 0xB0 → 0b1011 0000 拉低行2
    //   KEY_PORT = 0xA0 → 0b0111 0000 拉低行3
    // 




    
    
    


    
    //------------------end------------------------

    //delay_ms(2); 

    // 获取列号
    KEY_PORT = 0xff;        //
    KEY_PORT = 0xF0;        // 行： 1111 0000 → 低4位列=0，高4位行=1
    temp = KEY_PORT & 0xF0; // 读取列电平

    // ============ 请在下面补充程序，完成获取按键的列号 col =？ ============
    // 获取列号 方法同上面说明只是将行列交换了




    //------------------end------------------------

    //等待按键释放    
    while((KEY_PORT&0xF0)!=0xF0);
    
    return _____________________________;  // 查表获取按键码，并返回
}


// ==================== 测试 ====================
// 以下是测试代码，使用串口发送按键值
void uart_init()
{
    SCON = 0x50;
    TMOd = 0x20;
    TH1 = TL1 = 0xfd;  //fosc =11.0592 ,波特率9600
    TR1 = 0;
}

void uart_send(uchar c)
{
    SBUF = c;
    while(TI ==0);
    TI = 0;
}

void Test()
{
    unsigned int key;

    uart_init();
    while (1)
    {
        key = KeyScan();
        if (key != 0xFF)
         {
           uart_send(key); // 发送按键值到串口					 
         }
				
     }

}
 


void main()
{
 	 Test();
}


