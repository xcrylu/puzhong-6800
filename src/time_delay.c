// time.c
// 演示延时
// by xcr
// 2026-4-8

#include<reg52.h>        /*包含头文件REG51.H*/
#include "common.h"



//===========宏定义===============
#define LED         P2        //LED控制端口
#define ON          0x00   
#define OFF            0xFF

#define KEY_ON  0
#define KEY_OFF 1

//======sfr bit定义==============
sbit KEY1=P3^0;
sbit KEY2=P3^1;

//======函数声明==================
void delay_ms_t0(uint x);    
void led_flash();
void led_flu_left(uchar x);
void led_flu_right(uchar x);


void main(){
    
    while(1){
        if(KEY1 == ON){
            led_flu_left(1);
        }else if(KEY2 == ON){
            led_flu_right(1);
        }else{
            led_flash();    
        }            
    }
}                                                

                                

//+---------------------------------------------------------------+
//|                          TMOD (89H)                           |
//+-------+-------+-------+-------+-------+-------+-------+-------+
//| Bit 7 | Bit 6 | Bit 5 | Bit 4 | Bit 3 | Bit 2 | Bit 1 | Bit 0 |
//+-------+-------+-------+-------+-------+-------+-------+-------+
//| GATE  | C/T#  |  M1   |  M0   | GATE  | C/T#  |  M1   |  M0   |
//+-------+-------+-------+-------+-------+-------+-------+-------+
//|          Timer 1 控制区       |          Timer 0 控制区       |
//+---------------------------------------------------------------+

//功能说明：
//GATE  ：门控位，1 时由 INTx 与 TRx 共同启动
//C/T#    ：0 = 定时，1 = 计数
//M1/M0    ：工作模式选择 (00~11)


//+---------------------------------------------------------------+
//|                          TCON (88H)                           |
//+-------+-------+-------+-------+-------+-------+-------+-------+
//| Bit 7 | Bit 6 | Bit 5 | Bit 4 | Bit 3 | Bit 2 | Bit 1 | Bit 0 |
//+-------+-------+-------+-------+-------+-------+-------+-------+
//|  TF1  |  TR1  |  TF0  |  TR0  |  IE1  |  IT1  |  IE0  |  IT0  |
//+-------+-------+-------+-------+-------+-------+-------+-------+
//|     Timer 1   |    Timer 0    |    外部中断 1 |  外部中断 0   |
//+---------------------------------------------------------------+

//功能说明：
//TF1  : Timer1 溢出标志
//TR1  : Timer1 运行控制
//TF0  : Timer0 溢出标志
//TR0  : Timer0 运行控制
//IE1  : 外部中断1标志
//IT1  : 外部中断1触发方式
//IE0  : 外部中断0标志
//IT0  : 外部中断0触发方式

//延时函数,延时x毫秒
void DelayMS(uint x)                    //延时函数
{
    uint j,k;                                    //定义无符号字符型变量j和k
    for(k=0;k<x;k++)                    //双重for循环语句实现软件延时 
        for(j=0;j<120;j++);            //循环体为空循环
}

//使用定时器0实现的延时函数
// 
void delay_ms_t0(uint x)
{ 
    uint i = 0;
    TMOD = 0x01;  //定时器0工作方式1。
    
    for(i = 0; i<x;i++){   //当时钟频率为12MHz时
        TH0 = 64536/256;     //1毫秒定时，定时器初值 x = 2^16-1000; 
        TL0 = 64536%256;
        TR0 = 1;             //启动定时器0
        while(TF0==0);       //等待定时器0溢出
        TF0=0;               //清除定时器0溢出标志
    }
    TR0 = 0; //关闭定时器0
}

void led_flash(void)
{
    LED = ON;
    delay_ms_t0(200);
    LED = OFF;
    delay_ms_t0(200);
}

void led_flu_left(uchar x)
{
    uchar i;
    while(x--){
        for(i =0 ;i<8;i++){
            LED = ~(0x01<<i);
            delay_ms_t0(500);
        }
    }
}

void led_flu_right(uchar x)
{
    uchar i;
    while(x--){
        for(i =0 ;i<8;i++){
            LED = ~(0x80>>i);
            delay_ms_t0(500);
        }
    }
}

